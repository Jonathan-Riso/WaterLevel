#include <Arduino.h>
#include <SPI.h>
#include <Wire.h>
#include <HCSR04.h>
#include <Adafruit_SSD1306.h>

#include <RollingAverage.hpp> 

// Distance Sensor
int triggerPin = 13;
int echoPin = 15;
RollingAverage distances(200);
 

// Display
#define SCREEN_WIDTH 128 // OLED display width, in pixels
#define SCREEN_HEIGHT 64 // OLED display height, in pixels
#define SCREEN_ADDRESS 0x3C ///< See datasheet for Address; 0x3D for 128x64, 0x3C for 128x32

int sclDisplay = 4;
int sdaDisplay = 5;
int i2cAddress = 0x3C; 
TwoWire I2C_Display = TwoWire(1); 
Adafruit_SSD1306 display(SCREEN_WIDTH, SCREEN_HEIGHT, &I2C_Display, -1);

// 'Full Cup', 124x64px
const unsigned char bitmap_FullCup [] PROGMEM = {
	0x00, 0x00, 0x00, 0x0f, 0x00, 0x00, 0x00, 0x00, 0x00, 0x00, 0x00, 0x00, 0x00, 0x00, 0x00, 0x00, 
	0x00, 0x00, 0x00, 0x0f, 0x00, 0x00, 0x00, 0x00, 0x00, 0x00, 0x00, 0x00, 0x00, 0x00, 0x00, 0x00, 
	0x00, 0x00, 0x0c, 0x0f, 0x00, 0x00, 0x00, 0x00, 0x00, 0x00, 0x00, 0x00, 0x00, 0x00, 0x00, 0x00, 
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	0x7f, 0xff, 0xff, 0xff, 0xff, 0xff, 0xff, 0xfc, 0x00, 0x00, 0x00, 0x00, 0x00, 0x00, 0x00, 0x00
};


// Distance Functions
int getWaterLevel(){
		
	// (Max - Current)/(Max - Min) * 100
	double* distance = HCSR04.measureDistanceMm(20);
	distances.addValue(*distance);
	
	int p = (float(480 - distances.getAverage())/float(480-220));

	
	if (distances.getAverage() > 480) { p = 0; }
	else if (p < 0) p = 0;
	if (p > 100) p = 100;
	return p;
}

// Display Functions
void updateCup(int p){
	int cupXStart1 = 5;
	int cupXEnd1 = 54;
	int cupXStart2 = 8;
	int cupXEnd2 = 52;
	int cupX2StartY = 52;
	int cupYStart = 22;
	int cupYEnd = 58;
	int linesTotalCount = cupYEnd - cupYStart;

	display.clearDisplay();
	display.drawBitmap(0,0, bitmap_FullCup, 124, 64, WHITE);
	
	int linesToRemove = float(1.0 - float(p/100.0)) * linesTotalCount;

	Serial.println(linesToRemove);
	
	if (linesToRemove > (cupX2StartY - cupYStart)) {
		display.fillRect(cupXStart1, cupYStart, (cupXEnd1-cupXStart1), (cupX2StartY-cupYStart), BLACK);
		linesToRemove = linesToRemove - (cupX2StartY-cupYStart);
		display.fillRect(cupXStart2, cupX2StartY, (cupXEnd2-cupXStart2), linesToRemove, BLACK);
	} else {
		display.fillRect(cupXStart1, cupYStart, (cupXEnd1-cupXStart1), linesToRemove, BLACK);
	}
}

void updateDisplay(int p){
	
	display.clearDisplay();

	updateCup(p);

	display.setCursor(80, 32);
    display.println(String(p)+"%");
    display.display();
}

void setup()
{
	delay(100);

	Serial.begin(115200);
	HCSR04.begin(triggerPin, echoPin);
	
	// Set up display
	I2C_Display.setPins(sdaDisplay, sclDisplay);
	if(!display.begin(SSD1306_SWITCHCAPVCC, SCREEN_ADDRESS)) {
		Serial.println(F("SSD1306 allocation failed"));
		while(1);
	}
	Serial.println("No Loop");
	display.clearDisplay();
	display.setTextColor(WHITE, BLACK);
	display.setTextSize(2);
	display.drawBitmap(0,0, bitmap_FullCup, 124, 64, WHITE);
	display.display();
}

void loop()
{
    int p = getWaterLevel();
	updateDisplay(p);
	delay(1000);
}

